## arch/riscv32/soc/riscv-privilege/jive/Kconfig.defconfig.series
```kconfig
if SOC_SERIES_RISCV32_JIVE

config SOC_SERIES
	string
	default "jive"

config SYS_CLOCK_HW_CYCLES_PER_SEC
	int
	default 12000000

config RISCV_SOC_INTERRUPT_INIT
	bool
	default n

config RISCV_HAS_CPU_IDLE
	bool
	default n

config RISCV_HAS_PLIC
	bool
	default n

config NUM_IRQS
	int
	default 8

config XIP
	bool
	default y

config RISCV_ROM_BASE_ADDR
	hex
	default 0x80000000

config RISCV_ROM_SIZE
	hex
	default 0x8000

config RISCV_RAM_BASE_ADDR
	hex
	default	0x80008000

config RISCV_RAM_SIZE
	hex
	default 0x8000

endif # SOC_SERIES_RISCV32_JIVE
```

## arch/riscv32/soc/riscv-privilege/jive/Kconfig.series
```kconfig
# Kconfig - RISCV32_JIVE implementation
#
# Copyright (c) 2018 Frédéric REQUIN
#

config SOC_SERIES_RISCV32_JIVE
	bool "ICE40ULP JiVe implementation"
	depends on RISCV32
	select SOC_FAMILY_RISCV_PRIVILEGE
	help
	Enable support for ICE40ULP JiVe
```

## arch/riscv32/soc/riscv-privilege/jive/Kconfig.soc
```kconfig
# Kconfig - RISCV32_JIVE configuration options
#
# Copyright (c) 2018 Frédéric REQUIN
#

choice
prompt "ICE40ULP JiVe system implementation"
depends on SOC_SERIES_RISCV32_JIVE

config SOC_RISCV32_JIVE
	bool "ICE40ULP JiVe system implementation"

endchoice
```

## boards/riscv32/ice40up5k_jive/Kconfig.board
```kconfig
config BOARD_ICE40UP5K_JIVE
	bool "Lattice Semiconductor ICE40UP5K dev board with JiVE CPU"
	depends on SOC_RISCV32_JIVE
```

## boards/riscv32/ice40up5k_jive/ice40up5k_jive_defconfig
```kconfig
CONFIG_RISCV32=y
CONFIG_SOC_SERIES_RISCV32_JIVE=y
CONFIG_SOC_RISCV32_JIVE=y
CONFIG_BOARD_ICE40UP5K_JIVE=y
CONFIG_CONSOLE=y
CONFIG_SERIAL=y
CONFIG_UART_JIVE=y
CONFIG_UART_JIVE_PORT_0=y
CONFIG_UART_JIVE_PORT_0_NAME="uart0"
CONFIG_UART_CONSOLE=y
CONFIG_UART_CONSOLE_ON_DEV_NAME="uart0"
CONFIG_PLIC=n
CONFIG_RISCV_MACHINE_TIMER=y
CONFIG_GPIO=n
CONFIG_XIP=y
```

## drivers/serial/Kconfig.jive
```kconfig
menuconfig UART_JIVE
	bool "JiVe UART driver"
	depends on SOC_RISCV32_JIVE
	select SERIAL_HAS_DRIVER
	help
	  Enable the JiVe UART driver.

menuconfig UART_JIVE_PORT_0
	bool "Enable JiVe Port 0"
	depends on UART_JIVE
	help
	  This tells the driver to configure the UART port at boot, depending on
	  the additional configuration options below.

config UART_JIVE_PORT_0_NAME
	string "Port 0 Device Name"
	default "uart0"
	depends on UART_JIVE_PORT_0
	help
	  This is the device name for UART, and is included in the device
	  struct.
```
